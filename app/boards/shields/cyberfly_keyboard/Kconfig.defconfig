## app/boards/shields/cyberfly_keyboard/Kconfig.defconfig
```kconfig
if SHIELD_CYBERFLY_KEYBOARD

config ZMK_KEYBOARD_NAME
    default "CyberFly KBD"

config CYBERFLY_RGB_STATUS_LED
    bool "RGB status LED indicator"
    default y
    select PWM
    select LED_PWM

config CYBERFLY_MOUSE_TEST
    bool "Fake mouse circle movement for BLE HID testing"
    default n
    depends on ZMK_POINTING

config CYBERFLY_AIR_MOUSE
    bool "Air mouse via QMI8658A IMU tilt-to-cursor"
    default n
    depends on ZMK_POINTING
    select SENSOR
    select QMI8658A

config CYBERFLY_I2C_SLAVE
    bool "Expose keys as I2C slave (CardKB/BBQ10-compatible superset)"
    default n
    depends on I2C
    select I2C_TARGET
    select I2C_TARGET_BUFFER_MODE
    help
      Expose the CyberFly keyboard as an I2C target device so another MCU
      can poll or read keypress/ASCII events. Default I2C address is 0x5F
      (M5 CardKB compatible). See cyberfly-i2c-slave-protocol.md.

config CYBERFLY_I2C_SLAVE_ADDR
    hex "I2C slave address (7-bit)"
    default 0x5F
    range 0x08 0x77
    depends on CYBERFLY_I2C_SLAVE
    help
      7-bit I2C slave address. 0x5F matches M5 CardKB/CardKB2.
      0x1F matches Solder Party BBQ10KBD.

config CYBERFLY_I2C_SLAVE_FIFO_DEPTH
    int "ASCII + event FIFO depth"
    default 31
    range 4 127
    depends on CYBERFLY_I2C_SLAVE

endif
```

## app/boards/shields/cyberfly_keyboard/Kconfig.shield
```kconfig
config SHIELD_CYBERFLY_KEYBOARD
    def_bool $(shields_list_contains,cyberfly_keyboard)
```

## app/dts/bindings/behaviors/cyberfly,behavior-reset-settings-bootloader.yaml
```yaml
# Copyright (c) 2025 CyberFly
# SPDX-License-Identifier: MIT

description: Erase NVS settings then reboot into UF2 bootloader

compatible: "cyberfly,behavior-reset-settings-bootloader"

include: zero_param.yaml
```

## app/dts/bindings/behaviors/cyberfly,behavior-toggle-mouse.yaml
```yaml
description: Toggle mouse on/off
compatible: "cyberfly,behavior-toggle-mouse"
include: zero_param.yaml
```
